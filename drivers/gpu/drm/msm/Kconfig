## drivers/gpu/drm/msm/Kconfig
```kconfig
config DRM_MSM
	tristate "MSM DRM"
	depends on DRM
	depends on ARCH_QCOM || (ARM && COMPILE_TEST)
	depends on OF
	depends on MMU
	select QCOM_MDT_LOADER if ARCH_QCOM
	select REGULATOR
	select DRM_KMS_HELPER
	select DRM_PANEL
	select SHMEM
	select TMPFS
	select QCOM_SCM
	select SND_SOC_HDMI_CODEC if SND_SOC
	select SYNC_FILE
	select MSM_EXT_DISPLAY
	select PM_GENERIC_DOMAINS
	default y
	help
	  DRM/KMS driver for MSM/snapdragon.

config DRM_MSM_REGISTER_LOGGING
	bool "MSM DRM register logging"
	depends on DRM_MSM
	default n
	help
	  Compile in support for logging register reads/writes in a format
	  that can be parsed by envytools demsm tool.  If enabled, register
	  logging can be switched on via msm.reglog=y module param.

config DRM_MSM_HDMI_HDCP
	bool "Enable HDMI HDCP support in MSM DRM driver"
	depends on DRM_MSM && QCOM_SCM
	default n
	help
	  Compile in support for logging register reads/writes in a format
	  that can be parsed by envytools demsm tool.  If enabled, register
	  logging can be switched on via msm.reglog=y module param.

config DRM_MSM_HDMI
	bool "Enable HDMI support in MSM DRM driver"
	depends on DRM_MSM
	depends on COMMON_CLK
	default n
	help
	  Compile in support for HDMI driver in msm drm
	  driver. HDMI external display support is enabled
	  through this config option. It can be primary or
	  secondary display on device.

config DRM_MSM_DSI
	bool "Enable DSI support in MSM DRM driver"
	depends on DRM_MSM
	select DRM_PANEL
	select DRM_MIPI_DSI
	default n
	help
	  Choose this option if you have a need for MIPI DSI connector
	  support.

config DRM_MSM_DSI_STAGING
	bool "Enable new DSI driver support in MSM DRM driver"
	depends on DRM_MSM
	select DRM_PANEL
	select DRM_MIPI_DSI
	default y
	help
	  Choose this option if you need MIPI DSI connector support on MSM
	  which conforms to DRM. MIPI stands for Mobile Industry Processor
	  Interface and DSI stands for Display Serial Interface which powers
	  the primary display of your mobile device.

config DRM_MSM_DSI_FOD_TOUCH_HBM
	bool "Drive the FOD HBM from the touchscreen by default"
	depends on DRM_MSM_DSI_STAGING && INPUT
	default n
	help
	  Turn the panel FOD HBM and fod_ui on while the touchscreen reports
	  BTN_INFO (finger on the in-display fingerprint sensor), instead of
	  waiting for SurfaceFlinger to mark the pressed layer with
	  FOD_PRESSED_LAYER_ZORDER. Needed by userspaces that draw their own
	  FOD light. It can still be toggled at runtime through the
	  fod_touch_hbm attribute of the DSI display device.

	  It also exposes the FOD HBM state as
	  /sys/class/lcd/panel/actual_mask_brightness (unless the LCD class
	  is enabled), which Samsung's fingerprint UI waits on before
	  drawing its light source.

config DRM_MSM_DSI_FOD_TOUCH_UI_DELAY_MS
	int "Delay before reporting the FOD UI as ready (ms)"
	depends on DRM_MSM_DSI_FOD_TOUCH_HBM
	range 0 1000
	default 0
	help
	  Time between turning on the touch-driven FOD HBM and setting
	  fod_ui, which tells the fingerprint HAL to start capturing. Lets a
	  light source drawn by userspace show up first. Can be changed at
	  runtime through the fod_ui_delay_ms attribute of the DSI display.

config DRM_MSM_DSI_FOD_SENSOR_POSITION
	string "Samsung-style in-display fingerprint sensor position"
	depends on DRM_MSM_DSI_FOD_TOUCH_HBM
	default ""
	help
	  Comma-separated sensor geometry in millimetres, exposed read-only
	  as /sys/class/fingerprint/fingerprint/position the way Samsung
	  kernels do: bottom margin, horizontal offset, sensor width, sensor
	  height, active area width and height, image width and height,
	  and so on. Samsung's lock screen reads it to keep the PIN pad
	  clear of the fingerprint icon. Leave empty to not create it.

config DSI_PARSER
	bool "Enable DSI panel configuration parser"
	depends on DYNAMIC_DEBUG
	default y
	help
	  Choose this option if you need text parser for a DSI panel
	  configurations which can parse a given text file and get the
	  panel configurations. Also, this module provides a set of APIs
	  which can be used to get the parsed data.

config DRM_MSM_DSI_PLL
	bool "Enable DSI PLL driver in MSM DRM"
	depends on DRM_MSM_DSI && COMMON_CLK
	default y
	help
	  Choose this option to enable DSI PLL driver which provides DSI
	  source clocks under common clock framework.

config DRM_MSM_DSI_28NM_PHY
	bool "Enable DSI 28nm PHY driver in MSM DRM"
	depends on DRM_MSM_DSI
	default y
	help
	  Choose this option if the 28nm DSI PHY is used on the platform.

config DRM_MSM_DSI_20NM_PHY
	bool "Enable DSI 20nm PHY driver in MSM DRM"
	depends on DRM_MSM_DSI
	default y
	help
	  Choose this option if the 20nm DSI PHY is used on the platform.

config DRM_MSM_DSI_28NM_8960_PHY
	bool "Enable DSI 28nm 8960 PHY driver in MSM DRM"
	depends on DRM_MSM_DSI
	default y
	help
	  Choose this option if the 28nm DSI PHY 8960 variant is used on the
	  platform.

config DRM_MSM_MDP5
	tristate "MSM MDP5 DRM driver"
	depends on DRM_MSM
	default n
	help
	  Choose this option if MSM MDP5 revision support is
	  needed in DRM/KMS. This is not required if sde/mdp4
	  only target enabled. MDP5 supports DSI and HDMI
	  displays.

config DRM_MSM_MDP4
	tristate "MSM MDP4 DRM driver"
	depends on DRM_MSM
	default n
	help
	  Choose this option if MSM MDP4 revision support is needed in DRM/KMS.
	  MSM MDP4 DRM driver should be disabled for other MDP revisions to
	  avoid possible conflicts.  Only select this option if the target
	  MSM platform is MDP4 based.

config DRM_MSM_HDCP
	tristate "HDCP for MSM DRM"
	depends on DRM_MSM
	default n
	help
	  Chose this option if High-bandwidth Digital Content Protection (HDCP)
	  support is needed in the MSM DRM/KMS driver.  Enabling this config
	  will allow HDCP encrypted (copy protected) media to be displayed.
	  This should only be enabled if required for platforms supporting HDCP
	  over the desired interface.

config DRM_SDE_WB
	bool "Enable Writeback support in SDE DRM"
	depends on DRM_MSM
	default y
	help
	  Choose this option for writeback connector support.
	  This option enables a virtual writeback connector where
	  the output image is written back to memory in the format
	  selected by the connector's mode and property settings.

config DRM_SDE_SHD
	bool "Enable Shared display support in SDE DRM"
	depends on DRM_MSM
	help
	  Choose this option for shared display support.
	  This option enables multiple logical displays
	  to share one base physical encoder/connector.
	  Each logical display will appear as different
	  connectors and report back to user.

config DRM_SDE_SHP
	bool "Enable Shared plane support in SDE DRM"
	depends on DRM_MSM
	help
	  Choose this option for shared plane support.
	  This option enables multiple logical planes
	  to share one base physical plane hardware.
	  Each logical plane will appear as different
	  planes and report back to user.

config DRM_MSM_DSI_14NM_PHY
	bool "Enable DSI 14nm PHY driver in MSM DRM (used by MSM8996/APQ8096)"
	depends on DRM_MSM_DSI
	default y
	help
	  Choose this option if DSI PHY on 8996 is used on the platform.

config DRM_SDE_EVTLOG_DEBUG
	bool "Enable event logging in MSM DRM"
	depends on DRM_MSM
	help
	  The SDE DRM debugging provides support to enable display debugging
	  features to: dump SDE registers during driver errors, panic
	  driver during fatal errors and enable some display-driver logging
	  into an internal buffer (this avoids logging overhead).

config DRM_SDE_RSC
	bool "Enable sde resource state coordinator(rsc) driver"
	depends on DRM_MSM
	help
	  The SDE DRM RSC provides display Resource State Coordinator support
	  to vote the ab/ib bandwidth for primary display. Each rsc client
	  can vote their active state. Any active request from any client
	  avoids the display core power collapse. A client can also register
	  for display core power collapse events on rsc.
```
